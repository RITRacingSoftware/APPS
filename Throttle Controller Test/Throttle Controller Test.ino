/****************************************************************************** 
MCP4725 Example Waveform Sketch
Joel Bartlett
SparkFun Electronics
Sept. 11, 2014
https://github.com/sparkfun/MCP4725_Breakout

This sketch takes data from a lookup table to provide 
waveforms to be generated by the MCP4725 DAC. 

Development environment specifics:
Arduino 1.0+
Hardware Version V14

This code is beerware; if you see me (or any other SparkFun employee) at the local, 
and you've found our code helpful, please buy us a round!

Distributed as-is; no warranty is given. 

This code builds off the sketch written by Mark VandeWettering, which can be found here:
http://brainwagon.org/2011/02/24/arduino-mcp4725-breakout-board/
*/

#include <Wire.h>//Include the Wire library to talk I2C

//This is the I2C Address of the MCP4725, by default (A0 pulled to GND).
//Please note that this breakout is for the MCP4725A0. 
#define MCP4725_ADDR 0x60   
//For devices with A0 pulled HIGH, use 0x61

//Sinewave Tables were generated using this calculator:
//http://www.daycounter.com/Calculators/Sine-Generator-Calculator.phtml


int lookup = 0;//varaible for navigating through the tables

int pedal_5_0v = A2;
int pedal_3_3v = A3;
int brake = 2;

int brakeState = 0;

int x = 0;

int value5_0 = 0;
int value3_3 = 0;

int scaled5_0 = 0;
int scaled3_3 = 0;


int sintab2[255] = 
{
0,
0,
0,
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3810,
3825


};


void setup()
{
  Wire.begin();
  Serial.begin(9600);
  pinMode(brake, INPUT);
  
 
}
//---------------------------------------------------
void loop()
{
  brakeState = digitalRead(brake);
  value5_0 = analogRead(pedal_5_0v);
  value3_3 = analogRead(pedal_3_3v);

  
  scaled5_0 = map(value5_0, 0, 1023, 0, 255);
  scaled3_3 = map(value3_3, 0, 675, 0, 255);
  
  Wire.beginTransmission(MCP4725_ADDR);
  Wire.write(64);                     // cmd to update the DAC
  Wire.write(sintab2[lookup] >> 4);        // the 8 most significant bits...
  Wire.write((sintab2[lookup] & 15) << 4); // the 4 least significant bits...
  Wire.endTransmission();
  
 
  if ((abs(scaled3_3 - scaled5_0) < 25 )){
    
  lookup  = scaled5_0;
  Serial.println("GOOD");
  Serial.println(value5_0);
  }

  if ((abs(scaled3_3 - scaled5_0) > 50 )){
    
  lookup  = 0;
  Serial.println("BAD");
  }

  if ((value5_0 > 180) && (brakeState == 1)){
    
    while(value5_0 > 150){
      Serial.println("fault");
      Serial.println(value5_0);
      value5_0 = analogRead(pedal_5_0v);
      lookup  = 0;
      Wire.beginTransmission(MCP4725_ADDR);
      Wire.write(64);                     // cmd to update the DAC
      Wire.write(sintab2[lookup] >> 4);        // the 8 most significant bits...
      Wire.write((sintab2[lookup] & 15) << 4); // the 4 least significant bits...
      Wire.endTransmission();
  
    }
   
  }
  
  
}
