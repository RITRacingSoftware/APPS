/*MCP4725 Example Waveform Sketch
Joel Bartlett
SparkFun Electronics
Sept. 11, 2014
https://github.com/sparkfun/MCP4725_Breakout

This sketch takes data from a lookup table to provide 
waveforms to be generated by the MCP4725 DAC. 

Development environment specifics:
Arduino 1.0+
Hardware Version V14

This code is beerware; if you see me (or any other SparkFun employee) at the local, 
and you've found our code helpful, please buy us a round!

Distributed as-is; no warranty is given. 

This code builds off the sketch written by Mark VandeWettering, which can be found here:
http://brainwagon.org/2011/02/24/arduino-mcp4725-breakout-board/
*/

#include <Wire.h>//Include the Wire library to talk I2C

//-------------------- INIT -------------------------

//This is the I2C Address of the MCP4725, by default (A0 pulled to GND).
//Please note that this breakout is for the MCP4725A0. 
#define MCP4725_ADDR 0x60   
//For devices with A0 pulled HIGH, use 0x61

//Sinewave Tables were generated using this calculator:
//http://www.daycounter.com/Calculators/Sine-Generator-Calculator.phtml

int lookup = 0; //varaible for navigating through the tables

int pedal_5_0v = A0;
int pedal_3_3v = A2;
int brakepedal = A7;

int value5_0 = 0;
int value3_3 = 0;
int brakevalue = 0;

int scaled5_0 = 0;
int scaled3_3 = 0;

bool latchBPPC;

#define ADC_MAX 1023
#define ADC_MAX_3V 675

#define NO_THROTTLE_5V 190
#define NO_THROTTLE_3V 70

#define OPEN_CIRCUIT_5V 1000 //~4.9V
#define OPEN_CIRCUIT_3V 655 //~3.2V

#define PLAUSIBILITY_THRESHOLD 45
#define BRAKE_THRESHOLD 125
#define THROTTLE_LATCH_SET 112
#define THROTTLE_LATCH_RESET 100

int sintab2[450] = 
{
500,
500,
500,
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3800,
3800
};
// 3800/4096 (12 bit DAC) -> ~4.64V

void setup()
{
  Wire.begin();
  
  latchBPPC = false;
}

//-------------------- MAIN -------------------------
void loop()
{
  brakevalue = analogRead(brakepedal);
  value5_0 = analogRead(pedal_5_0v);
  value3_3 = analogRead(pedal_3_3v);

  // 5V @ no throttle: ~0.92V -> 190/1024 low limit (10 bit ADC)
  if (value5_0 < NO_THROTTLE_5V || value5_0 >= OPEN_CIRCUIT_5V) {
    value5_0 = NO_THROTTLE_5V;
  }
  scaled5_0 = map(value5_0, NO_THROTTLE_5V, ADC_MAX, 0, 450);
  
  // 3.3V @ no throttle: ~0.34V -> 70/675 low limit (3.3V on DAC)
  if (value3_3 < NO_THROTTLE_3V || value3_3 >= OPEN_CIRCUIT_3V) {
    value3_3 = NO_THROTTLE_3V;
  }
  scaled3_3 = map(value3_3, NO_THROTTLE_3V, ADC_MAX_3V, 0, 450);
 
  if ((abs(scaled3_3 - scaled5_0) < PLAUSIBILITY_THRESHOLD )){
    // use the average index
    lookup  = (scaled5_0 + scaled3_3) >> 1;
  }
  else {
    // if the difference is too big, something went wrong
    // set a low voltage so no torque is requested
    lookup = 0;
  }
  
  // don't request torque if the brakes are on 
  // and the throttle is pressed more than 25% 
  
  // 125/1024 is the ADC value when the brakes are on 
  // 112 is ~25% of 450 lookup range
  if (brakevalue > BRAKE_THRESHOLD && lookup > THROTTLE_LATCH_SET) {
    latchBPPC = true; 
    lookup = 0;
  } 
  // keep latched until throttle is < 5%
  else if (lookup > THROTTLE_LATCH_RESET && latchBPPC) {
    lookup = 0; 
  }
  else {
    latchBPPC = false; // clear latch
  }

  // Write to DAC
  Wire.beginTransmission(MCP4725_ADDR);
  Wire.write(64);                     // cmd to update the DAC
  Wire.write(sintab2[lookup] >> 4);        // the 8 most significant bits...
  Wire.write((sintab2[lookup] & 15) << 4); // the 4 least significant bits...
  Wire.endTransmission();
} // loop()
